;
; File Name: cyfitteriar.inc
; 
; PSoC Creator  4.4
;
; Description:
; 
;
;-------------------------------------------------------------------------------
; Copyright (c) 2007-2020 Cypress Semiconductor.  All rights reserved.
; You may use this file only in accordance with the license, terms, conditions, 
; disclaimers, and limitations in the end user license agreement accompanying 
; the software package with which this file was provided.
;-------------------------------------------------------------------------------

#ifndef INCLUDED_CYFITTERIAR_INC
#define INCLUDED_CYFITTERIAR_INC
    INCLUDE cydeviceiar.inc
    INCLUDE cydeviceiar_trm.inc

/* Clock */
Clock__CFG0 EQU CYREG_CLKDIST_DCFG0_CFG0
Clock__CFG1 EQU CYREG_CLKDIST_DCFG0_CFG1
Clock__CFG2 EQU CYREG_CLKDIST_DCFG0_CFG2
Clock__CFG2_SRC_SEL_MASK EQU 0x07
Clock__INDEX EQU 0x00
Clock__PM_ACT_CFG EQU CYREG_PM_ACT_CFG2
Clock__PM_ACT_MSK EQU 0x01
Clock__PM_STBY_CFG EQU CYREG_PM_STBY_CFG2
Clock__PM_STBY_MSK EQU 0x01

/* c_out */
c_out__0__INTTYPE EQU CYREG_PICU0_INTTYPE0
c_out__0__MASK EQU 0x01
c_out__0__PC EQU CYREG_PRT0_PC0
c_out__0__PORT EQU 0
c_out__0__SHIFT EQU 0
c_out__1__INTTYPE EQU CYREG_PICU0_INTTYPE1
c_out__1__MASK EQU 0x02
c_out__1__PC EQU CYREG_PRT0_PC1
c_out__1__PORT EQU 0
c_out__1__SHIFT EQU 1
c_out__2__INTTYPE EQU CYREG_PICU0_INTTYPE2
c_out__2__MASK EQU 0x04
c_out__2__PC EQU CYREG_PRT0_PC2
c_out__2__PORT EQU 0
c_out__2__SHIFT EQU 2
c_out__AG EQU CYREG_PRT0_AG
c_out__AMUX EQU CYREG_PRT0_AMUX
c_out__BIE EQU CYREG_PRT0_BIE
c_out__BIT_MASK EQU CYREG_PRT0_BIT_MASK
c_out__BYP EQU CYREG_PRT0_BYP
c_out__CTL EQU CYREG_PRT0_CTL
c_out__DM0 EQU CYREG_PRT0_DM0
c_out__DM1 EQU CYREG_PRT0_DM1
c_out__DM2 EQU CYREG_PRT0_DM2
c_out__DR EQU CYREG_PRT0_DR
c_out__INP_DIS EQU CYREG_PRT0_INP_DIS
c_out__INTTYPE_BASE EQU CYDEV_PICU_INTTYPE_PICU0_BASE
c_out__LCD_COM_SEG EQU CYREG_PRT0_LCD_COM_SEG
c_out__LCD_EN EQU CYREG_PRT0_LCD_EN
c_out__MASK EQU 0x07
c_out__PORT EQU 0
c_out__PRT EQU CYREG_PRT0_PRT
c_out__PRTDSI__CAPS_SEL EQU CYREG_PRT0_CAPS_SEL
c_out__PRTDSI__DBL_SYNC_IN EQU CYREG_PRT0_DBL_SYNC_IN
c_out__PRTDSI__OE_SEL0 EQU CYREG_PRT0_OE_SEL0
c_out__PRTDSI__OE_SEL1 EQU CYREG_PRT0_OE_SEL1
c_out__PRTDSI__OUT_SEL0 EQU CYREG_PRT0_OUT_SEL0
c_out__PRTDSI__OUT_SEL1 EQU CYREG_PRT0_OUT_SEL1
c_out__PRTDSI__SYNC_OUT EQU CYREG_PRT0_SYNC_OUT
c_out__PS EQU CYREG_PRT0_PS
c_out__SHIFT EQU 0
c_out__SLW EQU CYREG_PRT0_SLW

/* start */
start__0__INTTYPE EQU CYREG_PICU2_INTTYPE2
start__0__MASK EQU 0x04
start__0__PC EQU CYREG_PRT2_PC2
start__0__PORT EQU 2
start__0__SHIFT EQU 2
start__AG EQU CYREG_PRT2_AG
start__AMUX EQU CYREG_PRT2_AMUX
start__BIE EQU CYREG_PRT2_BIE
start__BIT_MASK EQU CYREG_PRT2_BIT_MASK
start__BYP EQU CYREG_PRT2_BYP
start__CTL EQU CYREG_PRT2_CTL
start__DM0 EQU CYREG_PRT2_DM0
start__DM1 EQU CYREG_PRT2_DM1
start__DM2 EQU CYREG_PRT2_DM2
start__DR EQU CYREG_PRT2_DR
start__INP_DIS EQU CYREG_PRT2_INP_DIS
start__INTTYPE_BASE EQU CYDEV_PICU_INTTYPE_PICU2_BASE
start__LCD_COM_SEG EQU CYREG_PRT2_LCD_COM_SEG
start__LCD_EN EQU CYREG_PRT2_LCD_EN
start__MASK EQU 0x04
start__PORT EQU 2
start__PRT EQU CYREG_PRT2_PRT
start__PRTDSI__CAPS_SEL EQU CYREG_PRT2_CAPS_SEL
start__PRTDSI__DBL_SYNC_IN EQU CYREG_PRT2_DBL_SYNC_IN
start__PRTDSI__OE_SEL0 EQU CYREG_PRT2_OE_SEL0
start__PRTDSI__OE_SEL1 EQU CYREG_PRT2_OE_SEL1
start__PRTDSI__OUT_SEL0 EQU CYREG_PRT2_OUT_SEL0
start__PRTDSI__OUT_SEL1 EQU CYREG_PRT2_OUT_SEL1
start__PRTDSI__SYNC_OUT EQU CYREG_PRT2_SYNC_OUT
start__PS EQU CYREG_PRT2_PS
start__SHIFT EQU 2
start__SLW EQU CYREG_PRT2_SLW

/* Rest_Pos */
Rest_Pos__0__INTTYPE EQU CYREG_PICU2_INTTYPE5
Rest_Pos__0__MASK EQU 0x20
Rest_Pos__0__PC EQU CYREG_PRT2_PC5
Rest_Pos__0__PORT EQU 2
Rest_Pos__0__SHIFT EQU 5
Rest_Pos__AG EQU CYREG_PRT2_AG
Rest_Pos__AMUX EQU CYREG_PRT2_AMUX
Rest_Pos__BIE EQU CYREG_PRT2_BIE
Rest_Pos__BIT_MASK EQU CYREG_PRT2_BIT_MASK
Rest_Pos__BYP EQU CYREG_PRT2_BYP
Rest_Pos__CTL EQU CYREG_PRT2_CTL
Rest_Pos__DM0 EQU CYREG_PRT2_DM0
Rest_Pos__DM1 EQU CYREG_PRT2_DM1
Rest_Pos__DM2 EQU CYREG_PRT2_DM2
Rest_Pos__DR EQU CYREG_PRT2_DR
Rest_Pos__INP_DIS EQU CYREG_PRT2_INP_DIS
Rest_Pos__INTTYPE_BASE EQU CYDEV_PICU_INTTYPE_PICU2_BASE
Rest_Pos__LCD_COM_SEG EQU CYREG_PRT2_LCD_COM_SEG
Rest_Pos__LCD_EN EQU CYREG_PRT2_LCD_EN
Rest_Pos__MASK EQU 0x20
Rest_Pos__PORT EQU 2
Rest_Pos__PRT EQU CYREG_PRT2_PRT
Rest_Pos__PRTDSI__CAPS_SEL EQU CYREG_PRT2_CAPS_SEL
Rest_Pos__PRTDSI__DBL_SYNC_IN EQU CYREG_PRT2_DBL_SYNC_IN
Rest_Pos__PRTDSI__OE_SEL0 EQU CYREG_PRT2_OE_SEL0
Rest_Pos__PRTDSI__OE_SEL1 EQU CYREG_PRT2_OE_SEL1
Rest_Pos__PRTDSI__OUT_SEL0 EQU CYREG_PRT2_OUT_SEL0
Rest_Pos__PRTDSI__OUT_SEL1 EQU CYREG_PRT2_OUT_SEL1
Rest_Pos__PRTDSI__SYNC_OUT EQU CYREG_PRT2_SYNC_OUT
Rest_Pos__PS EQU CYREG_PRT2_PS
Rest_Pos__SHIFT EQU 5
Rest_Pos__SLW EQU CYREG_PRT2_SLW

/* Work_Pos */
Work_Pos__0__INTTYPE EQU CYREG_PICU2_INTTYPE6
Work_Pos__0__MASK EQU 0x40
Work_Pos__0__PC EQU CYREG_PRT2_PC6
Work_Pos__0__PORT EQU 2
Work_Pos__0__SHIFT EQU 6
Work_Pos__AG EQU CYREG_PRT2_AG
Work_Pos__AMUX EQU CYREG_PRT2_AMUX
Work_Pos__BIE EQU CYREG_PRT2_BIE
Work_Pos__BIT_MASK EQU CYREG_PRT2_BIT_MASK
Work_Pos__BYP EQU CYREG_PRT2_BYP
Work_Pos__CTL EQU CYREG_PRT2_CTL
Work_Pos__DM0 EQU CYREG_PRT2_DM0
Work_Pos__DM1 EQU CYREG_PRT2_DM1
Work_Pos__DM2 EQU CYREG_PRT2_DM2
Work_Pos__DR EQU CYREG_PRT2_DR
Work_Pos__INP_DIS EQU CYREG_PRT2_INP_DIS
Work_Pos__INTTYPE_BASE EQU CYDEV_PICU_INTTYPE_PICU2_BASE
Work_Pos__LCD_COM_SEG EQU CYREG_PRT2_LCD_COM_SEG
Work_Pos__LCD_EN EQU CYREG_PRT2_LCD_EN
Work_Pos__MASK EQU 0x40
Work_Pos__PORT EQU 2
Work_Pos__PRT EQU CYREG_PRT2_PRT
Work_Pos__PRTDSI__CAPS_SEL EQU CYREG_PRT2_CAPS_SEL
Work_Pos__PRTDSI__DBL_SYNC_IN EQU CYREG_PRT2_DBL_SYNC_IN
Work_Pos__PRTDSI__OE_SEL0 EQU CYREG_PRT2_OE_SEL0
Work_Pos__PRTDSI__OE_SEL1 EQU CYREG_PRT2_OE_SEL1
Work_Pos__PRTDSI__OUT_SEL0 EQU CYREG_PRT2_OUT_SEL0
Work_Pos__PRTDSI__OUT_SEL1 EQU CYREG_PRT2_OUT_SEL1
Work_Pos__PRTDSI__SYNC_OUT EQU CYREG_PRT2_SYNC_OUT
Work_Pos__PS EQU CYREG_PRT2_PS
Work_Pos__SHIFT EQU 6
Work_Pos__SLW EQU CYREG_PRT2_SLW

/* count_en */
count_en__0__INTTYPE EQU CYREG_PICU2_INTTYPE7
count_en__0__MASK EQU 0x80
count_en__0__PC EQU CYREG_PRT2_PC7
count_en__0__PORT EQU 2
count_en__0__SHIFT EQU 7
count_en__AG EQU CYREG_PRT2_AG
count_en__AMUX EQU CYREG_PRT2_AMUX
count_en__BIE EQU CYREG_PRT2_BIE
count_en__BIT_MASK EQU CYREG_PRT2_BIT_MASK
count_en__BYP EQU CYREG_PRT2_BYP
count_en__CTL EQU CYREG_PRT2_CTL
count_en__DM0 EQU CYREG_PRT2_DM0
count_en__DM1 EQU CYREG_PRT2_DM1
count_en__DM2 EQU CYREG_PRT2_DM2
count_en__DR EQU CYREG_PRT2_DR
count_en__INP_DIS EQU CYREG_PRT2_INP_DIS
count_en__INTTYPE_BASE EQU CYDEV_PICU_INTTYPE_PICU2_BASE
count_en__LCD_COM_SEG EQU CYREG_PRT2_LCD_COM_SEG
count_en__LCD_EN EQU CYREG_PRT2_LCD_EN
count_en__MASK EQU 0x80
count_en__PORT EQU 2
count_en__PRT EQU CYREG_PRT2_PRT
count_en__PRTDSI__CAPS_SEL EQU CYREG_PRT2_CAPS_SEL
count_en__PRTDSI__DBL_SYNC_IN EQU CYREG_PRT2_DBL_SYNC_IN
count_en__PRTDSI__OE_SEL0 EQU CYREG_PRT2_OE_SEL0
count_en__PRTDSI__OE_SEL1 EQU CYREG_PRT2_OE_SEL1
count_en__PRTDSI__OUT_SEL0 EQU CYREG_PRT2_OUT_SEL0
count_en__PRTDSI__OUT_SEL1 EQU CYREG_PRT2_OUT_SEL1
count_en__PRTDSI__SYNC_OUT EQU CYREG_PRT2_SYNC_OUT
count_en__PS EQU CYREG_PRT2_PS
count_en__SHIFT EQU 7
count_en__SLW EQU CYREG_PRT2_SLW

/* Rest_Sensor */
Rest_Sensor__0__INTTYPE EQU CYREG_PICU2_INTTYPE3
Rest_Sensor__0__MASK EQU 0x08
Rest_Sensor__0__PC EQU CYREG_PRT2_PC3
Rest_Sensor__0__PORT EQU 2
Rest_Sensor__0__SHIFT EQU 3
Rest_Sensor__AG EQU CYREG_PRT2_AG
Rest_Sensor__AMUX EQU CYREG_PRT2_AMUX
Rest_Sensor__BIE EQU CYREG_PRT2_BIE
Rest_Sensor__BIT_MASK EQU CYREG_PRT2_BIT_MASK
Rest_Sensor__BYP EQU CYREG_PRT2_BYP
Rest_Sensor__CTL EQU CYREG_PRT2_CTL
Rest_Sensor__DM0 EQU CYREG_PRT2_DM0
Rest_Sensor__DM1 EQU CYREG_PRT2_DM1
Rest_Sensor__DM2 EQU CYREG_PRT2_DM2
Rest_Sensor__DR EQU CYREG_PRT2_DR
Rest_Sensor__INP_DIS EQU CYREG_PRT2_INP_DIS
Rest_Sensor__INTTYPE_BASE EQU CYDEV_PICU_INTTYPE_PICU2_BASE
Rest_Sensor__LCD_COM_SEG EQU CYREG_PRT2_LCD_COM_SEG
Rest_Sensor__LCD_EN EQU CYREG_PRT2_LCD_EN
Rest_Sensor__MASK EQU 0x08
Rest_Sensor__PORT EQU 2
Rest_Sensor__PRT EQU CYREG_PRT2_PRT
Rest_Sensor__PRTDSI__CAPS_SEL EQU CYREG_PRT2_CAPS_SEL
Rest_Sensor__PRTDSI__DBL_SYNC_IN EQU CYREG_PRT2_DBL_SYNC_IN
Rest_Sensor__PRTDSI__OE_SEL0 EQU CYREG_PRT2_OE_SEL0
Rest_Sensor__PRTDSI__OE_SEL1 EQU CYREG_PRT2_OE_SEL1
Rest_Sensor__PRTDSI__OUT_SEL0 EQU CYREG_PRT2_OUT_SEL0
Rest_Sensor__PRTDSI__OUT_SEL1 EQU CYREG_PRT2_OUT_SEL1
Rest_Sensor__PRTDSI__SYNC_OUT EQU CYREG_PRT2_SYNC_OUT
Rest_Sensor__PS EQU CYREG_PRT2_PS
Rest_Sensor__SHIFT EQU 3
Rest_Sensor__SLW EQU CYREG_PRT2_SLW

/* Work_Sensor */
Work_Sensor__0__INTTYPE EQU CYREG_PICU2_INTTYPE4
Work_Sensor__0__MASK EQU 0x10
Work_Sensor__0__PC EQU CYREG_PRT2_PC4
Work_Sensor__0__PORT EQU 2
Work_Sensor__0__SHIFT EQU 4
Work_Sensor__AG EQU CYREG_PRT2_AG
Work_Sensor__AMUX EQU CYREG_PRT2_AMUX
Work_Sensor__BIE EQU CYREG_PRT2_BIE
Work_Sensor__BIT_MASK EQU CYREG_PRT2_BIT_MASK
Work_Sensor__BYP EQU CYREG_PRT2_BYP
Work_Sensor__CTL EQU CYREG_PRT2_CTL
Work_Sensor__DM0 EQU CYREG_PRT2_DM0
Work_Sensor__DM1 EQU CYREG_PRT2_DM1
Work_Sensor__DM2 EQU CYREG_PRT2_DM2
Work_Sensor__DR EQU CYREG_PRT2_DR
Work_Sensor__INP_DIS EQU CYREG_PRT2_INP_DIS
Work_Sensor__INTTYPE_BASE EQU CYDEV_PICU_INTTYPE_PICU2_BASE
Work_Sensor__LCD_COM_SEG EQU CYREG_PRT2_LCD_COM_SEG
Work_Sensor__LCD_EN EQU CYREG_PRT2_LCD_EN
Work_Sensor__MASK EQU 0x10
Work_Sensor__PORT EQU 2
Work_Sensor__PRT EQU CYREG_PRT2_PRT
Work_Sensor__PRTDSI__CAPS_SEL EQU CYREG_PRT2_CAPS_SEL
Work_Sensor__PRTDSI__DBL_SYNC_IN EQU CYREG_PRT2_DBL_SYNC_IN
Work_Sensor__PRTDSI__OE_SEL0 EQU CYREG_PRT2_OE_SEL0
Work_Sensor__PRTDSI__OE_SEL1 EQU CYREG_PRT2_OE_SEL1
Work_Sensor__PRTDSI__OUT_SEL0 EQU CYREG_PRT2_OUT_SEL0
Work_Sensor__PRTDSI__OUT_SEL1 EQU CYREG_PRT2_OUT_SEL1
Work_Sensor__PRTDSI__SYNC_OUT EQU CYREG_PRT2_SYNC_OUT
Work_Sensor__PS EQU CYREG_PRT2_PS
Work_Sensor__SHIFT EQU 4
Work_Sensor__SLW EQU CYREG_PRT2_SLW

/* Miscellaneous */
BCLK__BUS_CLK__HZ EQU 24000000
BCLK__BUS_CLK__KHZ EQU 24000
BCLK__BUS_CLK__MHZ EQU 24
CYDEV_CHIP_DIE_LEOPARD EQU 1
CYDEV_CHIP_DIE_PSOC4A EQU 26
CYDEV_CHIP_DIE_PSOC5LP EQU 2
CYDEV_CHIP_DIE_PSOC5TM EQU 3
CYDEV_CHIP_DIE_TMA4 EQU 4
CYDEV_CHIP_DIE_UNKNOWN EQU 0
CYDEV_CHIP_FAMILY_FM0P EQU 5
CYDEV_CHIP_FAMILY_FM3 EQU 6
CYDEV_CHIP_FAMILY_FM4 EQU 7
CYDEV_CHIP_FAMILY_PSOC3 EQU 1
CYDEV_CHIP_FAMILY_PSOC4 EQU 2
CYDEV_CHIP_FAMILY_PSOC5 EQU 3
CYDEV_CHIP_FAMILY_PSOC6 EQU 4
CYDEV_CHIP_FAMILY_UNKNOWN EQU 0
CYDEV_CHIP_FAMILY_USED EQU CYDEV_CHIP_FAMILY_PSOC5
CYDEV_CHIP_JTAG_ID EQU 0x2E161069
CYDEV_CHIP_MEMBER_3A EQU 1
CYDEV_CHIP_MEMBER_4A EQU 26
CYDEV_CHIP_MEMBER_4AA EQU 25
CYDEV_CHIP_MEMBER_4AB EQU 30
CYDEV_CHIP_MEMBER_4AC EQU 14
CYDEV_CHIP_MEMBER_4AD EQU 15
CYDEV_CHIP_MEMBER_4AE EQU 16
CYDEV_CHIP_MEMBER_4D EQU 20
CYDEV_CHIP_MEMBER_4E EQU 6
CYDEV_CHIP_MEMBER_4F EQU 27
CYDEV_CHIP_MEMBER_4G EQU 4
CYDEV_CHIP_MEMBER_4H EQU 24
CYDEV_CHIP_MEMBER_4I EQU 32
CYDEV_CHIP_MEMBER_4J EQU 21
CYDEV_CHIP_MEMBER_4K EQU 22
CYDEV_CHIP_MEMBER_4L EQU 31
CYDEV_CHIP_MEMBER_4M EQU 29
CYDEV_CHIP_MEMBER_4N EQU 11
CYDEV_CHIP_MEMBER_4O EQU 8
CYDEV_CHIP_MEMBER_4P EQU 28
CYDEV_CHIP_MEMBER_4Q EQU 17
CYDEV_CHIP_MEMBER_4R EQU 9
CYDEV_CHIP_MEMBER_4S EQU 12
CYDEV_CHIP_MEMBER_4T EQU 10
CYDEV_CHIP_MEMBER_4U EQU 5
CYDEV_CHIP_MEMBER_4V EQU 23
CYDEV_CHIP_MEMBER_4W EQU 13
CYDEV_CHIP_MEMBER_4X EQU 7
CYDEV_CHIP_MEMBER_4Y EQU 18
CYDEV_CHIP_MEMBER_4Z EQU 19
CYDEV_CHIP_MEMBER_5A EQU 3
CYDEV_CHIP_MEMBER_5B EQU 2
CYDEV_CHIP_MEMBER_6A EQU 33
CYDEV_CHIP_MEMBER_FM3 EQU 37
CYDEV_CHIP_MEMBER_FM4 EQU 38
CYDEV_CHIP_MEMBER_PDL_FM0P_TYPE1 EQU 34
CYDEV_CHIP_MEMBER_PDL_FM0P_TYPE2 EQU 35
CYDEV_CHIP_MEMBER_PDL_FM0P_TYPE3 EQU 36
CYDEV_CHIP_MEMBER_UNKNOWN EQU 0
CYDEV_CHIP_MEMBER_USED EQU CYDEV_CHIP_MEMBER_5B
CYDEV_CHIP_DIE_EXPECT EQU CYDEV_CHIP_MEMBER_USED
CYDEV_CHIP_DIE_ACTUAL EQU CYDEV_CHIP_DIE_EXPECT
CYDEV_CHIP_REV_LEOPARD_ES1 EQU 0
CYDEV_CHIP_REV_LEOPARD_ES2 EQU 1
CYDEV_CHIP_REV_LEOPARD_ES3 EQU 3
CYDEV_CHIP_REV_LEOPARD_PRODUCTION EQU 3
CYDEV_CHIP_REV_PSOC4A_ES0 EQU 17
CYDEV_CHIP_REV_PSOC4A_PRODUCTION EQU 17
CYDEV_CHIP_REV_PSOC5LP_ES0 EQU 0
CYDEV_CHIP_REV_PSOC5LP_PRODUCTION EQU 0
CYDEV_CHIP_REV_PSOC5TM_ES0 EQU 0
CYDEV_CHIP_REV_PSOC5TM_ES1 EQU 1
CYDEV_CHIP_REV_PSOC5TM_PRODUCTION EQU 1
CYDEV_CHIP_REV_TMA4_ES EQU 17
CYDEV_CHIP_REV_TMA4_ES2 EQU 33
CYDEV_CHIP_REV_TMA4_PRODUCTION EQU 17
CYDEV_CHIP_REVISION_3A_ES1 EQU 0
CYDEV_CHIP_REVISION_3A_ES2 EQU 1
CYDEV_CHIP_REVISION_3A_ES3 EQU 3
CYDEV_CHIP_REVISION_3A_PRODUCTION EQU 3
CYDEV_CHIP_REVISION_4A_ES0 EQU 17
CYDEV_CHIP_REVISION_4A_PRODUCTION EQU 17
CYDEV_CHIP_REVISION_4AA_PRODUCTION EQU 0
CYDEV_CHIP_REVISION_4AB_PRODUCTION EQU 0
CYDEV_CHIP_REVISION_4AC_PRODUCTION EQU 0
CYDEV_CHIP_REVISION_4AD_PRODUCTION EQU 0
CYDEV_CHIP_REVISION_4AE_PRODUCTION EQU 0
CYDEV_CHIP_REVISION_4D_PRODUCTION EQU 0
CYDEV_CHIP_REVISION_4E_CCG2_NO_USBPD EQU 0
CYDEV_CHIP_REVISION_4E_PRODUCTION EQU 0
CYDEV_CHIP_REVISION_4F_PRODUCTION EQU 0
CYDEV_CHIP_REVISION_4F_PRODUCTION_256DMA EQU 0
CYDEV_CHIP_REVISION_4F_PRODUCTION_256K EQU 0
CYDEV_CHIP_REVISION_4G_ES EQU 17
CYDEV_CHIP_REVISION_4G_ES2 EQU 33
CYDEV_CHIP_REVISION_4G_PRODUCTION EQU 17
CYDEV_CHIP_REVISION_4H_PRODUCTION EQU 0
CYDEV_CHIP_REVISION_4I_PRODUCTION EQU 0
CYDEV_CHIP_REVISION_4J_PRODUCTION EQU 0
CYDEV_CHIP_REVISION_4K_PRODUCTION EQU 0
CYDEV_CHIP_REVISION_4L_PRODUCTION EQU 0
CYDEV_CHIP_REVISION_4M_PRODUCTION EQU 0
CYDEV_CHIP_REVISION_4N_PRODUCTION EQU 0
CYDEV_CHIP_REVISION_4O_PRODUCTION EQU 0
CYDEV_CHIP_REVISION_4P_PRODUCTION EQU 0
CYDEV_CHIP_REVISION_4Q_PRODUCTION EQU 0
CYDEV_CHIP_REVISION_4R_PRODUCTION EQU 0
CYDEV_CHIP_REVISION_4S_PRODUCTION EQU 0
CYDEV_CHIP_REVISION_4T_PRODUCTION EQU 0
CYDEV_CHIP_REVISION_4U_PRODUCTION EQU 0
CYDEV_CHIP_REVISION_4V_PRODUCTION EQU 0
CYDEV_CHIP_REVISION_4W_PRODUCTION EQU 0
CYDEV_CHIP_REVISION_4X_PRODUCTION EQU 0
CYDEV_CHIP_REVISION_4Y_PRODUCTION EQU 0
CYDEV_CHIP_REVISION_4Z_PRODUCTION EQU 0
CYDEV_CHIP_REVISION_5A_ES0 EQU 0
CYDEV_CHIP_REVISION_5A_ES1 EQU 1
CYDEV_CHIP_REVISION_5A_PRODUCTION EQU 1
CYDEV_CHIP_REVISION_5B_ES0 EQU 0
CYDEV_CHIP_REVISION_5B_PRODUCTION EQU 0
CYDEV_CHIP_REVISION_6A_ES EQU 17
CYDEV_CHIP_REVISION_6A_NO_UDB EQU 33
CYDEV_CHIP_REVISION_6A_PRODUCTION EQU 33
CYDEV_CHIP_REVISION_FM3_PRODUCTION EQU 0
CYDEV_CHIP_REVISION_FM4_PRODUCTION EQU 0
CYDEV_CHIP_REVISION_PDL_FM0P_TYPE1_PRODUCTION EQU 0
CYDEV_CHIP_REVISION_PDL_FM0P_TYPE2_PRODUCTION EQU 0
CYDEV_CHIP_REVISION_PDL_FM0P_TYPE3_PRODUCTION EQU 0
CYDEV_CHIP_REVISION_USED EQU CYDEV_CHIP_REVISION_5B_PRODUCTION
CYDEV_CHIP_REV_EXPECT EQU CYDEV_CHIP_REVISION_USED
CYDEV_CONFIG_FASTBOOT_ENABLED EQU 1
CYDEV_CONFIG_UNUSED_IO_AllowButWarn EQU 0
CYDEV_CONFIG_UNUSED_IO EQU CYDEV_CONFIG_UNUSED_IO_AllowButWarn
CYDEV_CONFIG_UNUSED_IO_AllowWithInfo EQU 1
CYDEV_CONFIG_UNUSED_IO_Disallowed EQU 2
CYDEV_CONFIGURATION_COMPRESSED EQU 1
CYDEV_CONFIGURATION_DMA EQU 0
CYDEV_CONFIGURATION_ECC EQU 1
CYDEV_CONFIGURATION_IMOENABLED EQU CYDEV_CONFIG_FASTBOOT_ENABLED
CYDEV_CONFIGURATION_MODE_COMPRESSED EQU 0
CYDEV_CONFIGURATION_MODE EQU CYDEV_CONFIGURATION_MODE_COMPRESSED
CYDEV_CONFIGURATION_MODE_DMA EQU 2
CYDEV_CONFIGURATION_MODE_UNCOMPRESSED EQU 1
CYDEV_DEBUG_ENABLE_MASK EQU 0x20
CYDEV_DEBUG_ENABLE_REGISTER EQU CYREG_MLOGIC_DEBUG
CYDEV_DEBUGGING_DPS_Disable EQU 3
CYDEV_DEBUGGING_DPS_JTAG_4 EQU 1
CYDEV_DEBUGGING_DPS_JTAG_5 EQU 0
CYDEV_DEBUGGING_DPS_SWD EQU 2
CYDEV_DEBUGGING_DPS_SWD_SWV EQU 6
CYDEV_DEBUGGING_DPS EQU CYDEV_DEBUGGING_DPS_SWD_SWV
CYDEV_DEBUGGING_ENABLE EQU 1
CYDEV_DEBUGGING_XRES EQU 0
CYDEV_DMA_CHANNELS_AVAILABLE EQU 24
CYDEV_ECC_ENABLE EQU 0
CYDEV_HEAP_SIZE EQU 0x80
CYDEV_INSTRUCT_CACHE_ENABLED EQU 1
CYDEV_INTR_RISING EQU 0x00000000
CYDEV_IS_EXPORTING_CODE EQU 0
CYDEV_IS_IMPORTING_CODE EQU 0
CYDEV_PROJ_TYPE EQU 0
CYDEV_PROJ_TYPE_BOOTLOADER EQU 1
CYDEV_PROJ_TYPE_LAUNCHER EQU 5
CYDEV_PROJ_TYPE_LOADABLE EQU 2
CYDEV_PROJ_TYPE_LOADABLEANDBOOTLOADER EQU 4
CYDEV_PROJ_TYPE_MULTIAPPBOOTLOADER EQU 3
CYDEV_PROJ_TYPE_STANDARD EQU 0
CYDEV_PROTECTION_ENABLE EQU 0
CYDEV_STACK_SIZE EQU 0x0800
CYDEV_USE_BUNDLED_CMSIS EQU 1
CYDEV_VARIABLE_VDDA EQU 0
CYDEV_VDDA_MV EQU 5000
CYDEV_VDDD_MV EQU 5000
CYDEV_VDDIO0_MV EQU 5000
CYDEV_VDDIO1_MV EQU 5000
CYDEV_VDDIO2_MV EQU 5000
CYDEV_VDDIO3_MV EQU 5000
CYDEV_VIO0_MV EQU 5000
CYDEV_VIO1_MV EQU 5000
CYDEV_VIO2_MV EQU 5000
CYDEV_VIO3_MV EQU 5000
CYIPBLOCK_ARM_CM3_VERSION EQU 0
CYIPBLOCK_P3_ANAIF_VERSION EQU 0
CYIPBLOCK_P3_CAN_VERSION EQU 0
CYIPBLOCK_P3_CAPSENSE_VERSION EQU 0
CYIPBLOCK_P3_COMP_VERSION EQU 0
CYIPBLOCK_P3_DECIMATOR_VERSION EQU 0
CYIPBLOCK_P3_DFB_VERSION EQU 0
CYIPBLOCK_P3_DMA_VERSION EQU 0
CYIPBLOCK_P3_DRQ_VERSION EQU 0
CYIPBLOCK_P3_DSM_VERSION EQU 0
CYIPBLOCK_P3_EMIF_VERSION EQU 0
CYIPBLOCK_P3_I2C_VERSION EQU 0
CYIPBLOCK_P3_LCD_VERSION EQU 0
CYIPBLOCK_P3_LPF_VERSION EQU 0
CYIPBLOCK_P3_OPAMP_VERSION EQU 0
CYIPBLOCK_P3_PM_VERSION EQU 0
CYIPBLOCK_P3_SCCT_VERSION EQU 0
CYIPBLOCK_P3_TIMER_VERSION EQU 0
CYIPBLOCK_P3_USB_VERSION EQU 0
CYIPBLOCK_P3_VIDAC_VERSION EQU 0
CYIPBLOCK_P3_VREF_VERSION EQU 0
CYIPBLOCK_S8_GPIO_VERSION EQU 0
CYIPBLOCK_S8_IRQ_VERSION EQU 0
CYIPBLOCK_S8_SAR_VERSION EQU 0
CYIPBLOCK_S8_SIO_VERSION EQU 0
CYIPBLOCK_S8_UDB_VERSION EQU 0
DMA_CHANNELS_USED__MASK0 EQU 0x00000000
CYDEV_BOOTLOADER_ENABLE EQU 0

#endif /* INCLUDED_CYFITTERIAR_INC */
